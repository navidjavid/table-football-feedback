#include "ea_dogl128.h"
#include "hardware/irq.h"
#include "hardware/regs/intctrl.h"
#include <string.h>

static DOGL128Config _cfg;
static uint8_t _fb[DOGL128_PAGES][DOGL128_WIDTH];

// 5x7 ASCII font (chars 32-126)
static const uint8_t font_5x7[][5] = {
    { 0x00, 0x00, 0x00, 0x00, 0x00 }, { 0x00, 0x00, 0x5F, 0x00, 0x00 },
    { 0x00, 0x07, 0x00, 0x07, 0x00 }, { 0x14, 0x7F, 0x14, 0x7F, 0x14 },
    { 0x24, 0x2A, 0x7F, 0x2A, 0x12 }, { 0x23, 0x13, 0x08, 0x64, 0x62 },
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    { 0x10, 0x08, 0x08, 0x10, 0x08 },
};

#define FONT_CELL_W  6
#define FONT_CELL_H  8

// Bit-bang SPI helpers — write commands/data with sleep_us delays
static void _bb_write(uint8_t byte) {
    for (int i = 7; i >= 0; i--) {
        gpio_put(_cfg.pin_sck, 0);
        gpio_put(_cfg.pin_mosi, (byte >> i) & 1);
        sleep_us(2);
        gpio_put(_cfg.pin_sck, 1);
        sleep_us(2);
    }
    gpio_put(_cfg.pin_sck, 0);
}

static void _cmd(uint8_t c) {
    gpio_put(_cfg.pin_a0, 0); gpio_put(_cfg.pin_cs, 0); sleep_us(5);
    _bb_write(c);
    gpio_put(_cfg.pin_cs, 1); sleep_us(10);
}

static void _dat(uint8_t d) {
    gpio_put(_cfg.pin_a0, 1); gpio_put(_cfg.pin_cs, 0); sleep_us(5);
    _bb_write(d);
    gpio_put(_cfg.pin_cs, 1); sleep_us(10);
}

void dogl128_init(const DOGL128Config *cfg) {
    _cfg = *cfg;

    gpio_init(_cfg.pin_sck);  gpio_set_dir(_cfg.pin_sck,  GPIO_OUT); gpio_put(_cfg.pin_sck, 0);
    gpio_init(_cfg.pin_mosi); gpio_set_dir(_cfg.pin_mosi, GPIO_OUT); gpio_put(_cfg.pin_mosi, 0);
    gpio_init(_cfg.pin_cs);   gpio_set_dir(_cfg.pin_cs,   GPIO_OUT); gpio_put(_cfg.pin_cs, 1);
    gpio_init(_cfg.pin_a0);   gpio_set_dir(_cfg.pin_a0,   GPIO_OUT); gpio_put(_cfg.pin_a0, 0);
    gpio_init(_cfg.pin_rst);  gpio_set_dir(_cfg.pin_rst,  GPIO_OUT); gpio_put(_cfg.pin_rst, 1);

    // Disable I2C IRQ during init to keep bit-bang timing clean
    irq_set_enabled(I2C0_IRQ, false);

    gpio_put(_cfg.pin_rst, 0); sleep_ms(100);
    gpio_put(_cfg.pin_rst, 1); sleep_ms(100);

    _cmd(0x40); sleep_ms(1);
    _cmd(0xA1); sleep_ms(1);
    _cmd(0xC0); sleep_ms(1);
    _cmd(0xA6); sleep_ms(1);
    _cmd(0xA2); sleep_ms(1);
    _cmd(0x2F); sleep_ms(50);
    _cmd(0xF8); sleep_ms(1);
    _cmd(0x00); sleep_ms(1);
    _cmd(0x27); sleep_ms(1);
    _cmd(0x81); sleep_ms(1);
    _cmd(cfg->contrast ? cfg->contrast : 0x13);
    sleep_ms(1);
    _cmd(0xAC); sleep_ms(1);
    _cmd(0x00); sleep_ms(1);
    _cmd(0xAF); sleep_ms(150);

    irq_set_enabled(I2C0_IRQ, true);

    dogl128_clear();
    dogl128_flush();
}

void dogl128_clear(void) {
    memset(_fb, 0x00, sizeof(_fb));
}

void dogl128_flush(void) {
    // Disable I2C IRQ during flush — bit-bang timing is sensitive
    irq_set_enabled(I2C0_IRQ, false);
    for (uint8_t page = 0; page < DOGL128_PAGES; page++) {
        _cmd(0xB0 | page);
        _cmd(0x10);
        _cmd(0x00);
        gpio_put(_cfg.pin_a0, 1);
        gpio_put(_cfg.pin_cs, 0);
        sleep_us(5);
        for (int col = 0; col < DOGL128_WIDTH; col++)
            _bb_write(_fb[page][col]);
        gpio_put(_cfg.pin_cs, 1);
        sleep_us(10);
    }
    irq_set_enabled(I2C0_IRQ, true);
}

void dogl128_set_pixel(int x, int y, bool on) {
    if (x < 0 || x >= DOGL128_WIDTH || y < 0 || y >= DOGL128_HEIGHT) return;
    if (on) _fb[y / 8][x] |=  (1 << (y % 8));
    else    _fb[y / 8][x] &= ~(1 << (y % 8));
}

void dogl128_draw_char(int x, int y, char c) {
    if (c < 32 || c > 126) c = ' ';
    const uint8_t *g = font_5x7[c - 32];
    for (int col = 0; col < 5; col++)
        for (int row = 0; row < 7; row++)
            if (g[col] & (1 << row))
                dogl128_set_pixel(x + col, y + row, true);
}

void dogl128_draw_char_2x(int x, int y, char c) {
    if (c < 32 || c > 126) c = ' ';
    const uint8_t *g = font_5x7[c - 32];
    for (int col = 0; col < 5; col++)
        for (int row = 0; row < 7; row++)
            if (g[col] & (1 << row)) {
                dogl128_set_pixel(x + col*2,     y + row*2,     true);
                dogl128_set_pixel(x + col*2 + 1, y + row*2,     true);
                dogl128_set_pixel(x + col*2,     y + row*2 + 1, true);
                dogl128_set_pixel(x + col*2 + 1, y + row*2 + 1, true);
            }
}

void dogl128_draw_string(int x, int y, const char *str) {
    int cx = x;
    while (*str) {
        if (cx + FONT_CELL_W > DOGL128_WIDTH) break;
        dogl128_draw_char(cx, y, *str++);
        cx += FONT_CELL_W;
    }
}

void dogl128_draw_string_2x(int x, int y, const char *str) {
    int cx = x;
    while (*str) {
        if (cx + 12 > DOGL128_WIDTH) break;
        dogl128_draw_char_2x(cx, y, *str++);
        cx += 12;
    }
}

void dogl128_print(int col, int row, const char *str) {
    dogl128_draw_string(col * FONT_CELL_W, row * FONT_CELL_H, str);
}

void dogl128_hline(int x, int y, int w) {
    for (int i = 0; i < w; i++) dogl128_set_pixel(x + i, y, true);
}
void dogl128_vline(int x, int y, int h) {
    for (int i = 0; i < h; i++) dogl128_set_pixel(x, y + i, true);
}
void dogl128_rect(int x, int y, int w, int h) {
    dogl128_hline(x, y, w);
    dogl128_hline(x, y + h - 1, w);
    dogl128_vline(x, y, h);
    dogl128_vline(x + w - 1, y, h);
}
void dogl128_fill_rect(int x, int y, int w, int h) {
    for (int j = 0; j < h; j++)
        for (int i = 0; i < w; i++)
            dogl128_set_pixel(x + i, y + j, true);
}
void dogl128_invert_rect(int x, int y, int w, int h) {
    for (int j = 0; j < h; j++)
        for (int i = 0; i < w; i++) {
            int xx = x + i, yy = y + j;
            if (xx < 0 || xx >= DOGL128_WIDTH || yy < 0 || yy >= DOGL128_HEIGHT) continue;
            _fb[yy / 8][xx] ^= (1 << (yy % 8));
        }
}

void dogl128_set_contrast(uint8_t val) {
    irq_set_enabled(I2C0_IRQ, false);
    _cmd(0x81);
    _cmd(val & 0x3F);
    irq_set_enabled(I2C0_IRQ, true);
}
